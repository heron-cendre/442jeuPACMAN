# file: Pacman_15_05.ioc
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ADC1.Channel-1\#ChannelRegularConversion=ADC_CHANNEL_0
ADC1.NbrOfConversionFlag=1
ADC1.Rank-1\#ChannelRegularConversion=1
ADC1.SamplingTime-1\#ChannelRegularConversion=ADC_SAMPLETIME_3CYCLES
ADC1.master=1
ADC3.Channel-0\#ChannelRegularConversion=ADC_CHANNEL_6
ADC3.Channel-IN6=ADC_CHANNEL_6
ADC3.Channel-IN7=ADC_CHANNEL_7
FMC.CASLatency1=FMC_SDRAM_CAS_LATENCY_3
FMC.ExitSelfRefreshDelay1=7
FMC.LoadToActiveDelay1=2
FMC.RCDDelay1=2
FMC.RPDelay1=2
FMC.RPDelay2=2
FMC.ReadBurst1=FMC_SDRAM_RBURST_ENABLE
FMC.ReadBurst2=FMC_SDRAM_RBURST_ENABLE
FMC.RowCycleDelay1=7
FMC.RowCycleDelay2=7
FMC.SDClockPeriod1=FMC_SDRAM_CLOCK_PERIOD_2
FMC.SDClockPeriod2=FMC_SDRAM_CLOCK_PERIOD_2
FMC.SelfRefreshTime1=4
FMC.WriteRecoveryTime1=3
FREERTOS.Queues01=queue_PacMan,16,uint16_t,0,Dynamic,NULL,NULL;queue_points,16,uint16_t,0,Dynamic,NULL,NULL;joystickQueue,32,uint32_t,0,Dynamic,NULL,NULL;vieQueue,16,uint16_t,0,Dynamic,NULL,NULL
FREERTOS.Tasks01=tache_jeu,1,128,fonction_jeu,Default,NULL,Dynamic,NULL,NULL;tache_affichage,0,1024,fonction_affichage,Default,NULL,Dynamic,NULL,NULL;tache_entrees,2,128,fonction_entrees,Default,NULL,Dynamic,NULL,NULL;tache_fantome,0,128,fonction_fantome,Default,NULL,Dynamic,NULL,NULL
I2C1.Timing=0x00C0EAFF
I2C3.Timing=0x00C0EAFF
LTDC.ActiveH=272
LTDC.ActiveW=480
LTDC.Alpha_L0=255
LTDC.BlendingFactor1_L0=LTDC_BLENDING_FACTOR1_PAxCA
LTDC.BlendingFactor2_L0=LTDC_BLENDING_FACTOR2_PAxCA
LTDC.FBStartAdress_L0=0xC0000000
LTDC.HBP=13
LTDC.HFP=32
LTDC.HSync=41
LTDC.ImageHeight_L0=272
LTDC.ImageWidth_L0=480
LTDC.Layers=0
LTDC.PixelFormat_L0=LTDC_PIXEL_FORMAT_RGB565
LTDC.VSync=10
LTDC.WindowX1_L0=480
LTDC.WindowY1_L0=272
Mcu.Family=STM32F7
Mcu.Name=STM32F746NGHx
Mcu.Package=TFBGA216
NVIC.DMA2D_IRQn=true\:5\:0\:false\:false\:true\:true\:true\:true\:true
NVIC.LTDC_IRQn=true\:5\:0\:false\:false\:true\:true\:true\:true\:true
NVIC.PriorityGroup=NVIC_PRIORITYGROUP_4
NVIC.TIM6_DAC_IRQn=true\:15\:0\:false\:false\:true\:false\:false\:true\:true
NVIC.TimeBase=TIM6_DAC_IRQn
NVIC.TimeBaseIP=TIM6
PA0/WKUP.Signal=ADCx_IN0
PA1.GPIO_Label=RMII_REF_CLK [LAN8742A-CZ-TR_REFCLK0]
PA1.Signal=ETH_REF_CLK
PA11.GPIO_Label=OTG_FS_N
PA11.Signal=USB_OTG_FS_DM
PA12.GPIO_Label=OTG_FS_P
PA12.Signal=USB_OTG_FS_DP
PA13.GPIO_Label=SWDIO
PA13.Mode=Trace_Asynchronous_SW
PA13.Signal=SYS_JTMS-SWDIO
PA14.GPIO_Label=SWCLK
PA14.Mode=Trace_Asynchronous_SW
PA14.Signal=SYS_JTCK-SWCLK
PA15.GPIO_Label=BP2
PA15.Signal=GPIO_Input
PA2.GPIO_Label=RMII_MDIO [LAN8742A-CZ-TR_MDIO]
PA2.Signal=ETH_MDIO
PA3.GPIO_Label=ULPI_D0 [USB3320C-EZK_D0]
PA3.Mode=Host_HS
PA3.Signal=USB_OTG_HS_ULPI_D0
PA4.Signal=COMP_DAC1_group
PA5.GPIO_Label=ULPI_CLK [USB3320C-EZK_CLKOUT]
PA5.Mode=Host_HS
PA5.Signal=USB_OTG_HS_ULPI_CK
PA6.Signal=GPIO_Input
PA7.GPIO_Label=RMII_CRS_DV [LAN8742A-CZ-TR_CRS_DV]
PA7.Signal=ETH_CRS_DV
PA8.GPIO_Label=BP1
PA8.Signal=GPIO_Input
PA9.GPIO_Label=VCP_TX [STM32F103CBT6_PA3]
PA9.GPIO_Mode=GPIO_MODE_AF_PP
PA9.GPIO_PuPd=GPIO_NOPULL
PA9.GPIO_Speed=GPIO_SPEED_FREQ_LOW
PA9.Mode=Asynchronous
PA9.Signal=USART1_TX
PB0.GPIO_Label=ULPI_D1 [USB3320C-EZK_D1]
PB0.Mode=Host_HS
PB0.Signal=USB_OTG_HS_ULPI_D1
PB1.GPIO_Label=ULPI_D2 [USB3320C-EZK_D2]
PB1.Mode=Host_HS
PB1.Signal=USB_OTG_HS_ULPI_D2
PB11.GPIO_Label=ULPI_D4 [USB3320C-EZK_D4]
PB11.Mode=Host_HS
PB11.Signal=USB_OTG_HS_ULPI_D4
PB12.GPIO_Label=ULPI_D5 [USB3320C-EZK_D5]
PB12.Mode=Host_HS
PB12.Signal=USB_OTG_HS_ULPI_D5
PB13.GPIO_Label=ULPI_D6 [USB3320C-EZK_D6]
PB13.Mode=Host_HS
PB13.Signal=USB_OTG_HS_ULPI_D6
PB14.GPIO_Label=ARDUINO MISO/D12
PB14.GPIO_Mode=GPIO_MODE_AF_PP
PB14.GPIO_PuPd=GPIO_NOPULL
PB14.GPIO_Speed=GPIO_SPEED_FREQ_LOW
PB14.Mode=Full_Duplex_Master
PB14.Signal=SPI2_MISO
PB15.GPIO_Label=ARDUINO MOSI/PWM/D11
PB15.GPIO_Mode=GPIO_MODE_AF_PP
PB15.GPIO_PuPd=GPIO_NOPULL
PB15.GPIO_Speed=GPIO_SPEED_FREQ_LOW
PB15.Mode=Full_Duplex_Master
PB15.Signal=SPI2_MOSI
PB2.Signal=QUADSPI_CLK
PB3.Mode=Trace_Asynchronous_SW
PB3.Signal=SYS_JTDO-SWO
PB5.GPIO_Label=ULPI_D7 [USB3320C-EZK_D7]
PB5.Mode=Host_HS
PB5.Signal=USB_OTG_HS_ULPI_D7
PB6.GPIO_Label=QSPI_NCS [N25Q128A13EF840E_S]
PB6.Signal=QUADSPI_BK1_NCS
PB7.GPIO_Label=VCP_RX [STM32F103CBT6_PA2]
PB7.GPIO_Mode=GPIO_MODE_AF_PP
PB7.GPIO_PuPd=GPIO_NOPULL
PB7.GPIO_Speed=GPIO_SPEED_FREQ_LOW
PB7.Mode=Asynchronous
PB7.Signal=USART1_RX
PB8.Mode=I2C
PB8.Signal=I2C1_SCL
PB9.Mode=I2C
PB9.Signal=I2C1_SDA
PC0.GPIO_Label=ULPI_STP [USB3320C-EZK_STP]
PC0.Mode=Host_HS
PC0.Signal=USB_OTG_HS_ULPI_STP
PC1.GPIO_Label=RMII_MDC [LAN8742A-CZ-TR_MDC]
PC1.Signal=ETH_MDC
PC10.GPIO_Label=SDMMC_D2
PC10.Signal=SDMMC1_D2
PC11.GPIO_Label=SDMMC_D3
PC11.Signal=SDMMC1_D3
PC12.GPIO_Label=SDMMC_CK
PC12.Signal=SDMMC1_CK
PC13.GPIO_Label=uSD_Detect
PC13.Signal=GPIO_Input
PC14/OSC32_IN.GPIO_Label=RCC_OSC32_IN
PC14/OSC32_IN.Mode=LSE-External-Oscillator
PC14/OSC32_IN.Signal=RCC_OSC32_IN
PC15/OSC32_OUT.GPIO_Label=RCC_OSC32_OUT
PC15/OSC32_OUT.Mode=LSE-External-Oscillator
PC15/OSC32_OUT.Signal=RCC_OSC32_OUT
PC2.GPIO_Label=ULPI_DIR [USB3320C-EZK_DIR]
PC2.Mode=Host_HS
PC2.Signal=USB_OTG_HS_ULPI_DIR
PC3.GPIO_Label=FMC_SDCKE0 [MT48LC4M32B2B5-6A_CKE]
PC3.Mode=SdramChipSelect1_1
PC3.Signal=FMC_SDCKE0
PC4.GPIO_Label=RMII_RXD0 [LAN8742A-CZ-TR_RXD0]
PC4.Signal=ETH_RXD0
PC5.GPIO_Label=RMII_RXD1 [LAN8742A-CZ-TR_RXD1]
PC5.Signal=ETH_RXD1
PC6.GPIO_Label=ARDUINO TX/D1
PC6.Mode=Asynchronous
PC6.Signal=USART6_TX
PC7.GPIO_Label=ARDUINO RX/D0
PC7.Mode=Asynchronous
PC7.Signal=USART6_RX
PC8.Signal=SDMMC1_D0
PC9.Signal=SDMMC1_D1
PD0.GPIO_Label=FMC_D2 [MT48LC4M32B2B5-6A_DQ2]
PD0.Signal=FMC_D2_DA2
PD1.GPIO_Label=FMC_D3 [MT48LC4M32B2B5-6A_DQ3]
PD1.Signal=FMC_D3_DA3
PD10.GPIO_Label=FMC_D15 [MT48LC4M32B2B5-6A_DQ15]
PD10.Signal=FMC_D15_DA15
PD11.GPIO_Label=QSPI_D0 [N25Q128A13EF840E_DQ0]
PD11.Signal=QUADSPI_BK1_IO0
PD12.GPIO_Label=QSPI_D1 [N25Q128A13EF840E_DQ1]
PD12.Signal=QUADSPI_BK1_IO1
PD13.GPIO_Label=QSPI_D3 [N25Q128A13EF840E_DQ3]
PD13.Signal=QUADSPI_BK1_IO3
PD14.GPIO_Label=FMC_D0 [MT48LC4M32B2B5-6A_DQ0]
PD14.Signal=FMC_D0_DA0
PD15.GPIO_Label=FMC_D1 [MT48LC4M32B2B5-6A_DQ1]
PD15.Signal=FMC_D1_DA1
PD2.GPIO_Label=SDMMC_CMD
PD2.Signal=SDMMC1_CMD
PD3.GPIO_Label=LED16
PD3.Signal=GPIO_Output
PD4.GPIO_Label=OTG_FS_OverCurrent [STMPS2141STR_Fault]
PD4.Signal=GPIO_Input
PD5.GPIO_Label=OTG_FS_PowerSwitchOn [STMPS2141STR_EN]
PD5.PinState=GPIO_PIN_SET
PD5.Signal=GPIO_Output
PD6.GPIO_Label=Audio_INT
PD6.GPIO_ModeDefaultEXTI=GPIO_MODE_EVT_RISING
PD6.Signal=GPXTI6
PD7.GPIO_Label=SPDIF_RX0 [74LVC1G04SE_4]
PD7.Signal=SPDIFRX_IN0
PD8.GPIO_Label=FMC_D13 [MT48LC4M32B2B5-6A_DQ13]
PD8.Signal=FMC_D13_DA13
PD9.GPIO_Label=FMC_D14 [MT48LC4M32B2B5-6A_DQ14]
PD9.Signal=FMC_D14_DA14
PE0.GPIO_Label=FMC_NBL0 [MT48LC4M32B2B5-6A_DQM0]
PE0.Signal=FMC_NBL0
PE1.GPIO_Label=FMC_NBL1 [MT48LC4M32B2B5-6A_DQM1]
PE1.Signal=FMC_NBL1
PE10.GPIO_Label=FMC_D7 [MT48LC4M32B2B5-6A_DQ7]
PE10.Signal=FMC_D7_DA7
PE11.GPIO_Label=FMC_D8 [MT48LC4M32B2B5-6A_DQ8]
PE11.Signal=FMC_D8_DA8
PE12.GPIO_Label=FMC_D9 [MT48LC4M32B2B5-6A_DQ9]
PE12.Signal=FMC_D9_DA9
PE13.GPIO_Label=FMC_D10 [MT48LC4M32B2B5-6A_DQ10]
PE13.Signal=FMC_D10_DA10
PE14.GPIO_Label=FMC_D11 [MT48LC4M32B2B5-6A_DQ11]
PE14.Signal=FMC_D11_DA11
PE15.GPIO_Label=FMC_D12 [MT48LC4M32B2B5-6A_DQ12]
PE15.Signal=FMC_D12_DA12
PE2.GPIO_Label=QSPI_D2 [N25Q128A13EF840E_DQ2]
PE2.Signal=QUADSPI_BK1_IO2
PE3.GPIO_Label=OTG_HS_OverCurrent [STMPS2151STR_FAULT]
PE3.Signal=GPIO_Input
PE4.GPIO_Label=LCD_B0 [RK043FN48H-CT672B_B0]
PE4.Mode=RGB888
PE4.Signal=LTDC_B0
PE5.GPIO_Label=LED14
PE5.Signal=GPIO_Output
PE6.GPIO_Label=LED15
PE6.Signal=GPIO_Output
PE7.GPIO_Label=FMC_D4 [MT48LC4M32B2B5-6A_DQ4]
PE7.Signal=FMC_D4_DA4
PE8.GPIO_Label=FMC_D5 [MT48LC4M32B2B5-6A_DQ5]
PE8.Signal=FMC_D5_DA5
PE9.GPIO_Label=FMC_D6 [MT48LC4M32B2B5-6A_DQ6]
PE9.Signal=FMC_D6_DA6
PF0.GPIO_Label=FMC_A0 [MT48LC4M32B2B5-6A_A0]
PF0.Signal=FMC_A0
PF1.GPIO_Label=FMC_A1 [MT48LC4M32B2B5-6A_A1]
PF1.Signal=FMC_A1
PF10.Mode=IN8
PF10.Signal=ADC3_IN8
PF11.GPIO_Label=FMC_SDNRAS [MT48LC4M32B2B5-6A_RAS]
PF11.Signal=FMC_SDNRAS
PF12.GPIO_Label=FMC_A6 [MT48LC4M32B2B5-6A_A6]
PF12.Signal=FMC_A6
PF13.GPIO_Label=FMC_A7 [MT48LC4M32B2B5-6A_A7]
PF13.Signal=FMC_A7
PF14.GPIO_Label=FMC_A8 [MT48LC4M32B2B5-6A_A8]
PF14.Signal=FMC_A8
PF15.GPIO_Label=FMC_A9 [MT48LC4M32B2B5-6A_A9]
PF15.Signal=FMC_A9
PF2.GPIO_Label=FMC_A2 [MT48LC4M32B2B5-6A_A2]
PF2.Signal=FMC_A2
PF3.GPIO_Label=FMC_A3 [MT48LC4M32B2B5-6A_A3]
PF3.Signal=FMC_A3
PF4.GPIO_Label=FMC_A4 [MT48LC4M32B2B5-6A_A4]
PF4.Signal=FMC_A4
PF5.GPIO_Label=FMC_A5 [MT48LC4M32B2B5-6A_A5]
PF5.Signal=FMC_A5
PF6.Mode=Asynchronous
PF6.Signal=UART7_RX
PF7.Mode=Asynchronous
PF7.Signal=UART7_TX
PF8.GPIO_Label=ARDUINO A3
PF8.GPIO_Mode=GPIO_MODE_ANALOG
PF8.GPIO_PuPd=GPIO_NOPULL
PF8.Mode=IN6
PF8.Signal=ADC3_IN6
PF9.GPIO_Label=ARDUINO A2
PF9.GPIO_Mode=GPIO_MODE_ANALOG
PF9.GPIO_PuPd=GPIO_NOPULL
PF9.Mode=IN7
PF9.Signal=ADC3_IN7
PG0.GPIO_Label=FMC_A10 [MT48LC4M32B2B5-6A_A10]
PG0.Signal=FMC_A10
PG1.GPIO_Label=FMC_A11 [MT48LC4M32B2B5-6A_A11]
PG1.Signal=FMC_A11
PG10.GPIO_Label=SAI2_SDB [WM8994ECS/R_ADCDAT1]
PG10.Signal=SAI2_SD_B
PG11.GPIO_Label=RMII_TX_EN [LAN8742A-CZ-TR_TXEN]
PG11.Signal=ETH_TX_EN
PG12.GPIO_Label=LCD_B4 [RK043FN48H-CT672B_B4]
PG12.Mode=RGB888
PG12.Signal=LTDC_B4
PG13.GPIO_Label=RMII_TXD0 [LAN8742A-CZ-TR_TXD0]
PG13.Signal=ETH_TXD0
PG14.GPIO_Label=RMII_TXD1 [LAN8742A-CZ-TR_TXD1]
PG14.Signal=ETH_TXD1
PG15.GPIO_Label=FMC_SDNCAS [MT48LC4M32B2B5-6A_CAS]
PG15.Signal=FMC_SDNCAS
PG2.GPIO_Label=RMII_RXER
PG2.Signal=GPIO_Input
PG3.GPIO_Label=EXT_RST
PG3.Signal=GPIO_Output
PG4.GPIO_Label=FMC_BA0 [MT48LC4M32B2B5-6A_BA0]
PG4.Signal=FMC_A14_BA0
PG5.GPIO_Label=FMC_BA1 [MT48LC4M32B2B5-6A_BA1]
PG5.Signal=FMC_A15_BA1
PG6.GPIO_Label=ARDUINO D2
PG6.Signal=GPIO_Output
PG7.GPIO_Label=ARDUINO D4
PG7.Signal=GPIO_Output
PG8.GPIO_Label=FMC_SDCLK [MT48LC4M32B2B5-6A_CLK]
PG8.Signal=FMC_SDCLK
PG9.Signal=GPIO_Input
PH0/OSC_IN.GPIO_Label=OSC_25M [NZ2520SB-25.00M_OUT]
PH0/OSC_IN.Mode=HSE-External-Oscillator
PH0/OSC_IN.Signal=RCC_OSC_IN
PH1/OSC_OUT.Mode=HSE-External-Oscillator
PH1/OSC_OUT.Signal=RCC_OSC_OUT
PH10.GPIO_Label=LED18
PH10.Signal=GPIO_Output
PH11.GPIO_Label=LED12
PH11.Signal=GPIO_Output
PH12.GPIO_Label=LED17
PH12.Signal=GPIO_Output
PH13.Signal=GPIO_Input
PH14.GPIO_Label=LED13
PH14.Signal=GPIO_Output
PH15.GPIO_Label=TP3
PH15.Signal=GPIO_Input
PH2.GPIO_Label=NC2
PH2.Signal=GPIO_Input
PH3.GPIO_Label=FMC_SDNE0 [MT48LC4M32B2B5-6A_CS]
PH3.Mode=SdramChipSelect1_1
PH3.Signal=FMC_SDNE0
PH4.GPIO_Label=ULPI_NXT [USB3320C-EZK_NXT]
PH4.Mode=Host_HS
PH4.Signal=USB_OTG_HS_ULPI_NXT
PH5.GPIO_Label=FMC_SDNME [MT48LC4M32B2B5-6A_WE]
PH5.Signal=FMC_SDNWE
PH6.GPIO_Label=LED2
PH6.Signal=GPIO_Output
PH7.GPIO_Label=LCD_SCL [RK043FN48H-CT672B_SCL]
PH7.GPIO_Pu=GPIO_PULLUP
PH7.Mode=I2C
PH7.Signal=I2C3_SCL
PH8.GPIO_Label=LCD_SDA [RK043FN48H-CT672B_SDA]
PH8.GPIO_Pu=GPIO_PULLUP
PH8.Mode=I2C
PH8.Signal=I2C3_SDA
PH9.GPIO_Label=LED11
PH9.Signal=GPIO_Output
PI0.Mode=NSS_Signal_Hard_Output
PI0.Signal=SPI2_NSS
PI1.Mode=Full_Duplex_Master
PI1.Signal=SPI2_SCK
PI10.GPIO_Label=LCD_HSYNC [RK043FN48H-CT672B_HSYNC]
PI10.Mode=RGB888
PI10.Signal=LTDC_HSYNC
PI12.GPIO_Label=LCD_DISP [RK043FN48H-CT672B_DISP] 
PI12.PinState=GPIO_PIN_SET
PI12.Signal=GPIO_Output
PI13.GPIO_Label=LCD_INT
PI13.GPIO_ModeDefaultEXTI=GPIO_MODE_EVT_RISING
PI13.Signal=GPXTI13
PI14.GPIO_Label=LCD_CLK [RK043FN48H-CT672B_CLK]
PI14.Mode=RGB888
PI14.Signal=LTDC_CLK
PI15.GPIO_Label=LCD_R0 [RK043FN48H-CT672B_R0]
PI15.Mode=RGB888
PI15.Signal=LTDC_R0
PI2.Signal=S_TIM8_CH4
PI4.GPIO_Label=SAI2_MCLKA [WM8994ECS/R_MCLK1]
PI4.Signal=SAI2_MCLK_A
PI5.GPIO_Label=SAI2_SCKA [WM8994ECS/R_BCLK1]
PI5.Signal=SAI2_SCK_A
PI6.GPIO_Label=SAI2_SDA [WM8994ECS/R_DACDAT1]
PI6.Signal=SAI2_SD_A
PI7.GPIO_Label=SAI2_FSA [WM8994ECS/R_LRCLK1]
PI7.Signal=SAI2_FS_A
PI8.GPIO_Label=NC1 [TP2]
PI8.Mode=Timestamp enabled - Input Enabled to TS
PI8.Signal=RTC_TS
PI9.GPIO_Label=LCD_VSYNC [RK043FN48H-CT672B_VSYNC]
PI9.Mode=RGB888
PI9.Signal=LTDC_VSYNC
PJ0.GPIO_Label=LCD_R1 [RK043FN48H-CT672B_R1]
PJ0.Mode=RGB888
PJ0.Signal=LTDC_R1
PJ1.GPIO_Label=LCD_R2 [RK043FN48H-CT672B_R2]
PJ1.Mode=RGB888
PJ1.Signal=LTDC_R2
PJ10.GPIO_Label=LCD_G3 [RK043FN48H-CT672B_G3]
PJ10.Mode=RGB888
PJ10.Signal=LTDC_G3
PJ11.GPIO_Label=LCD_G4 [RK043FN48H-CT672B_G4]
PJ11.Mode=RGB888
PJ11.Signal=LTDC_G4
PJ12.GPIO_Label=OTG_FS_VBUS
PJ12.Signal=GPIO_Input
PJ13.GPIO_Label=LCD_B1 [RK043FN48H-CT672B_B1]
PJ13.Mode=RGB888
PJ13.Signal=LTDC_B1
PJ14.GPIO_Label=LCD_B2 [RK043FN48H-CT672B_B2]
PJ14.Mode=RGB888
PJ14.Signal=LTDC_B2
PJ15.GPIO_Label=LCD_B3 [RK043FN48H-CT672B_B3]
PJ15.Mode=RGB888
PJ15.Signal=LTDC_B3
PJ2.GPIO_Label=LCD_R3 [RK043FN48H-CT672B_R3]
PJ2.Mode=RGB888
PJ2.Signal=LTDC_R3
PJ3.GPIO_Label=LCD_R4 [RK043FN48H-CT672B_R4]
PJ3.Mode=RGB888
PJ3.Signal=LTDC_R4
PJ4.GPIO_Label=LCD_R5 [RK043FN48H-CT672B_R5]
PJ4.Mode=RGB888
PJ4.Signal=LTDC_R5
PJ5.GPIO_Label=LCD_R6 [RK043FN48H-CT672B_R6]
PJ5.Mode=RGB888
PJ5.Signal=LTDC_R6
PJ6.GPIO_Label=LCD_R7 [RK043FN48H-CT672B_R7]
PJ6.Mode=RGB888
PJ6.Signal=LTDC_R7
PJ7.GPIO_Label=LCD_G0 [RK043FN48H-CT672B_G0]
PJ7.Mode=RGB888
PJ7.Signal=LTDC_G0
PJ8.GPIO_Label=LCD_G1 [RK043FN48H-CT672B_G1]
PJ8.Mode=RGB888
PJ8.Signal=LTDC_G1
PJ9.GPIO_Label=LCD_G2 [RK043FN48H-CT672B_G2]
PJ9.Mode=RGB888
PJ9.Signal=LTDC_G2
PK0.GPIO_Label=LCD_G5 [RK043FN48H-CT672B_G5]
PK0.Mode=RGB888
PK0.Signal=LTDC_G5
PK1.GPIO_Label=LCD_G6 [RK043FN48H-CT672B_G6]
PK1.Mode=RGB888
PK1.Signal=LTDC_G6
PK2.GPIO_Label=LCD_G7 [RK043FN48H-CT672B_G7]
PK2.Mode=RGB888
PK2.Signal=LTDC_G7
PK3.GPIO_Label=LCD_BL_CTRL [STLD40DPUR_EN]
PK3.GPIO_Speed=GPIO_SPEED_FREQ_LOW
PK3.PinState=GPIO_PIN_SET
PK3.Signal=GPIO_Output
PK4.GPIO_Label=LCD_B5 [RK043FN48H-CT672B_B5]
PK4.Mode=RGB888
PK4.Signal=LTDC_B5
PK5.GPIO_Label=LCD_B6 [RK043FN48H-CT672B_B6]
PK5.Mode=RGB888
PK5.Signal=LTDC_B6
PK6.GPIO_Label=LCD_B7 [RK043FN48H-CT672B_B7]
PK6.Mode=RGB888
PK6.Signal=LTDC_B7
PK7.GPIO_Label=LCD_DE [RK043FN48H-CT672B_DE]
PK7.Mode=RGB888
PK7.Signal=LTDC_DE
ProjectManager.HeapSize=0x200
ProjectManager.StackSize=0x400
ProjectManager.TargetToolchain=STM32CubeIDE
RCC.AHBFreq_Value=200000000
RCC.APB1CLKDivider=RCC_HCLK_DIV4
RCC.APB1Freq_Value=50000000
RCC.APB1TimFreq_Value=100000000
RCC.APB2CLKDivider=RCC_HCLK_DIV2
RCC.APB2Freq_Value=100000000
RCC.APB2TimFreq_Value=200000000
RCC.CortexFreq_Value=200000000
RCC.HCLKFreq_Value=200000000
RCC.HSE_VALUE=25000000
RCC.HSI_VALUE=16000000
RCC.PLL48CLockSelection=RCC_CLK48SOURCE_PLLSAIP
RCC.PLLI2SN=100
RCC.PLLM=25
RCC.PLLN=400
RCC.PLLQ=9
RCC.PLLSAIN=384
RCC.PLLSAIP=RCC_PLLSAIP_DIV8
RCC.PLLSAIR=5
RCC.PLLSAIRDiv=RCC_PLLSAIDIVR_8
RCC.PLLSourceVirtual=RCC_PLLSOURCE_HSE
RCC.SDMMCClockSelection=RCC_SDMMC1CLKSOURCE_CLK48
RCC.SYSCLKFreq_VALUE=200000000
RCC.SYSCLKSource=RCC_SYSCLKSOURCE_PLLCLK
RCC.USBFreq_Value=48000000
RCC.VCOOutputFreq_Value=400000000
RTC.Alarm-Alarm\ A=RTC_ALARM_A
RTC.Alarm_B-Alarm\ B=RTC_ALARM_B
SH.ADCx_IN0.0=ADC1_IN0,IN0
SH.COMP_DAC1_group.0=DAC_OUT1,DAC_OUT1
SH.FMC_A0.0=FMC_A0,12b-sda1
SH.FMC_A1.0=FMC_A1,12b-sda1
SH.FMC_A10.0=FMC_A10,12b-sda1
SH.FMC_A11.0=FMC_A11,12b-sda1
SH.FMC_A14_BA0.0=FMC_BA0,FourSdramBanks1
SH.FMC_A15_BA1.0=FMC_BA1,FourSdramBanks1
SH.FMC_A2.0=FMC_A2,12b-sda1
SH.FMC_A3.0=FMC_A3,12b-sda1
SH.FMC_A4.0=FMC_A4,12b-sda1
SH.FMC_A5.0=FMC_A5,12b-sda1
SH.FMC_A6.0=FMC_A6,12b-sda1
SH.FMC_A7.0=FMC_A7,12b-sda1
SH.FMC_A8.0=FMC_A8,12b-sda1
SH.FMC_A9.0=FMC_A9,12b-sda1
SH.FMC_D0_DA0.0=FMC_D0,sd-16b-d1
SH.FMC_D10_DA10.0=FMC_D10,sd-16b-d1
SH.FMC_D11_DA11.0=FMC_D11,sd-16b-d1
SH.FMC_D12_DA12.0=FMC_D12,sd-16b-d1
SH.FMC_D13_DA13.0=FMC_D13,sd-16b-d1
SH.FMC_D14_DA14.0=FMC_D14,sd-16b-d1
SH.FMC_D15_DA15.0=FMC_D15,sd-16b-d1
SH.FMC_D1_DA1.0=FMC_D1,sd-16b-d1
SH.FMC_D2_DA2.0=FMC_D2,sd-16b-d1
SH.FMC_D3_DA3.0=FMC_D3,sd-16b-d1
SH.FMC_D4_DA4.0=FMC_D4,sd-16b-d1
SH.FMC_D5_DA5.0=FMC_D5,sd-16b-d1
SH.FMC_D6_DA6.0=FMC_D6,sd-16b-d1
SH.FMC_D7_DA7.0=FMC_D7,sd-16b-d1
SH.FMC_D8_DA8.0=FMC_D8,sd-16b-d1
SH.FMC_D9_DA9.0=FMC_D9,sd-16b-d1
SH.FMC_NBL0.0=FMC_NBL0,Sd2ByteEnable1
SH.FMC_NBL1.0=FMC_NBL1,Sd2ByteEnable1
SH.FMC_SDCLK.0=FMC_SDCLK,12b-sda1
SH.FMC_SDNCAS.0=FMC_SDNCAS,12b-sda1
SH.FMC_SDNRAS.0=FMC_SDNRAS,12b-sda1
SH.FMC_SDNWE.0=FMC_SDNWE,12b-sda1
SH.S_TIM8_CH4.0=TIM8_CH4
SPI2.CalculateBaudRate=25.0 MBits/s
SPI2.Direction=SPI_DIRECTION_2LINES
SPI2.Mode=SPI_MODE_MASTER
SPI2.VirtualNSS=VM_NSSHARD
SPI2.VirtualType=VM_MASTER
TIM5.Channel-PWM\ Generation4\ CH4=TIM_CHANNEL_4
USART1.VirtualMode-Asynchronous=VM_ASYNC
USART6.VirtualMode-Asynchronous=VM_ASYNC
VP_DMA2D_VS_DMA2D.Mode=DMA2D_Activate
VP_FREERTOS_VS_CMSIS_V1.Mode=CMSIS_V1
VP_RTC_VS_RTC_Activate.Mode=RTC_Enabled
VP_RTC_VS_RTC_Alarm_A_Intern.Mode=Alarm A
VP_RTC_VS_RTC_Alarm_B_Intern.Mode=Alarm B
VP_RTC_VS_RTC_Calendar.Mode=RTC_Calendar
VP_SYS_VS_tim6.Mode=TIM6
VP_TIM1_VS_ClockSourceINT.Mode=Internal
VP_TIM2_VS_ClockSourceINT.Mode=Internal
VP_TIM3_VS_ClockSourceINT.Mode=Internal
VP_TIM5_VS_ClockSourceINT.Mode=Internal
VP_TIM8_VS_ClockSourceINT.Mode=Internal
board=STM32F746G-DISCO

// file: Core/Src/main.c
/* DEBUT DU CODE UTILISATEUR EN-TETE */
/**
 ******************************************************************************
 * Fichier           : main.c
 * Description       : Corps principal du programme
 ******************************************************************************
 * Attention
 *
 * Copyright (c) 2022 STMicroelectronics.
 * Tous droits reserves.
 *
 * Ce logiciel est sous licence selon les termes du fichier LICENSE dans le dossier racine de ce composant logiciel.
 * Si aucun fichier LICENSE n'est fourni avec ce logiciel, il est fourni TEL QUEL.
 *
 ******************************************************************************
 */
/* FIN DU CODE UTILISATEUR EN-TETE */
#include "main.h"
#include "cmsis_os.h"
#include "adc.h"
#include "dac.h"
#include "dma2d.h"
#include "i2c.h"
#include "ltdc.h"
#include "rtc.h"
#include "spi.h"
#include "tim.h"
#include "usart.h"
#include "gpio.h"
#include "fmc.h"

/* USER CODE BEGIN Includes */
#include "stm32746g_discovery_lcd.h"
#include "stm32746g_discovery_ts.h"
#include "stdio.h"
#include "maze.h"

/* USER CODE END Includes */

/* USER CODE BEGIN PV */

// Dimensions de l'ecran LCD
#define LCD_LONGUEUR 480
#define LCD_LARGEUR 272

// Variables globales (definies dans maze.h)

uint32_t joystick_v = 0, joystick_h = 0;
PacMan pacman;
GameState etat = STATE_MENU;

// Ajouter les variables globales de minuterie manquantes pour l'etat du jeu
uint32_t last_update_time = 0;
uint32_t ghost_update_time = 0;
uint32_t state_change_delay = 0;
uint32_t animation_time = 0;

/* USER CODE END PV */

void SystemClock_Config(void);
void MX_FREERTOS_Init(void);

/**
  * @brief  Point d'entree de l'application
  * @retval int
  */
int main(void)
{

  /* MCU Configuration--------------------------------------------------------*/

  /* Reset of all peripherals, Initializes the Flash interface and the Systick. */
  HAL_Init();

  /* Configure the system clock */
  SystemClock_Config();

  /* Initialize all configured peripherals */
  MX_GPIO_Init();
  MX_ADC3_Init();
  MX_DMA2D_Init();
  MX_FMC_Init();
  MX_I2C1_Init();
  MX_I2C3_Init();
  MX_LTDC_Init();
  MX_RTC_Init();
  MX_SPI2_Init();
  MX_TIM1_Init();
  MX_TIM2_Init();
  MX_TIM3_Init();
  MX_TIM5_Init();
  MX_TIM8_Init();
  MX_USART1_UART_Init();
  MX_USART6_UART_Init();
  MX_ADC1_Init();
  MX_DAC_Init();
  MX_UART7_Init();
  /* USER CODE BEGIN 2 */
  // Initialiser l'ecran LCD
  BSP_LCD_Init();
  BSP_LCD_LayerDefaultInit(0, LCD_FB_START_ADDRESS);
  BSP_LCD_LayerDefaultInit(1, LCD_FB_START_ADDRESS + BSP_LCD_GetXSize()*BSP_LCD_GetYSize()*4);
  BSP_LCD_SelectLayer(0);
  BSP_LCD_DisplayOn();
  BSP_LCD_Clear(LCD_COLOR_BLACK);

  // Initialiser l'ecran tactile
  BSP_TS_Init(BSP_LCD_GetXSize(), BSP_LCD_GetYSize());

  // Demarrer l'ADC pour le joystick et les potentiometres
  HAL_ADC_Start(&hadc1);
  HAL_ADC_Start(&hadc3);

  /* USER CODE END 2 */

  /* Call init function for freertos objects (in cmsis_os2.c) */
  MX_FREERTOS_Init();

  /* Start scheduler */
  osKernelStart();

  /* We should never get here as control is now taken by the scheduler */

  /* Infinite loop */
  while (1)
  {

  }
}

/**
  * @brief Configuration de l'horloge du systeme
  * @retval None
  */
void SystemClock_Config(void)
{
  RCC_OscInitTypeDef RCC_OscInitStruct = {0};
  RCC_ClkInitTypeDef RCC_ClkInitStruct = {0};

  /** Configurer la capacite de pilotage LSE */
  HAL_PWR_EnableBkUpAccess();

  /** Configurer la tension de sortie du regulateur principal interne */
  __HAL_RCC_PWR_CLK_ENABLE();
  __HAL_PWR_VOLTAGESCALING_CONFIG(PWR_REGULATOR_VOLTAGE_SCALE1);

  /** Initialiser les oscillateurs RCC selon les parametres specifies dans la structure RCC_OscInitTypeDef. */
  RCC_OscInitStruct.OscillatorType = RCC_OSCILLATORTYPE_LSI|RCC_OSCILLATORTYPE_HSE;
  RCC_OscInitStruct.HSEState = RCC_HSE_ON;
  RCC_OscInitStruct.LSIState = RCC_LSI_ON;
  RCC_OscInitStruct.PLL.PLLState = RCC_PLL_ON;
  RCC_OscInitStruct.PLL.PLLSource = RCC_PLLSOURCE_HSE;
  RCC_OscInitStruct.PLL.PLLM = 25;
  RCC_OscInitStruct.PLL.PLLN = 400;
  RCC_OscInitStruct.PLL.PLLP = RCC_PLLP_DIV2;
  RCC_OscInitStruct.PLL.PLLQ = 9;
  if (HAL_RCC_OscConfig(&RCC_OscInitStruct) != HAL_OK)
  {
    Error_Handler();
  }

  /** Activer le mode Over-Drive */
  if (HAL_PWREx_EnableOverDrive() != HAL_OK)
  {
    Error_Handler();
  }

  /** Initialiser les horloges CPU, AHB et APB */
  RCC_ClkInitStruct.ClockType = RCC_CLOCKTYPE_HCLK|RCC_CLOCKTYPE_SYSCLK
                              |RCC_CLOCKTYPE_PCLK1|RCC_CLOCKTYPE_PCLK2;
  RCC_ClkInitStruct.SYSCLKSource = RCC_SYSCLKSOURCE_PLLCLK;
  RCC_ClkInitStruct.AHBCLKDivider = RCC_SYSCLK_DIV1;
  RCC_ClkInitStruct.APB1CLKDivider = RCC_HCLK_DIV4;
  RCC_ClkInitStruct.APB2CLKDivider = RCC_HCLK_DIV2;

  if (HAL_RCC_ClockConfig(&RCC_ClkInitStruct, FLASH_LATENCY_6) != HAL_OK)
  {
    Error_Handler();
  }
}

/**
  * @brief  Callback de periode ecoulee en mode non bloquant
  * @note   Cette fonction est appelee lorsque l'interruption TIM6 a eu lieu, a l'interieur de HAL_TIM_IRQHandler(). Elle appelle directement HAL_IncTick() pour incrementer une variable globale "uwTick" utilisee comme base de temps de l'application.
  * @param  htim : handle TIM
  * @retval None
  */
void HAL_TIM_PeriodElapsedCallback(TIM_HandleTypeDef *htim)
{
  if (htim->Instance == TIM6) {
    HAL_IncTick();
  }
}

/**
  * @brief  Cette fonction est executee en cas d'erreur.
  * @retval None
  */
void Error_Handler(void)
{
  /* USER CODE BEGIN Debug Error_Handler */
	/* L'utilisateur peut ajouter sa propre implementation pour signaler l'etat de retour d'erreur HAL */
	__disable_irq();
	while (1)
	{
	}
  /* USER CODE END Debug Error_Handler */
}

#ifdef  USE_FULL_ASSERT
/**
  * @brief  Signale le nom du fichier source et le numero de ligne source ou l'erreur assert_param s'est produite.
  * @param  file: pointeur vers le nom du fichier source
  * @param  line: numero de ligne source de l'erreur assert_param
  * @retval None
  */
void assert_failed(uint8_t *file, uint32_t line)
{
  /* USER CODE BEGIN 6 */
	/* L'utilisateur peut ajouter sa propre implementation pour signaler le nom du fichier et le numero de ligne,
     ex: printf("Mauvaise valeur de parametres : fichier %s a la ligne %d\r\n", file, line) */
  /* USER CODE END 6 */
}
#endif /* USE_FULL_ASSERT */

// file: Core/Src/freertos.c
/* DEBUT DU CODE UTILISATEUR EN-TETE */
/**
  ******************************************************************************
  * Nom du fichier          : freertos.c
  * Description             : Code pour les applications freertos
  ******************************************************************************
  * Attention
  *
  * Copyright (c) 2025 STMicroelectronics.
  * Tous droits reserves.
  *
  * Ce logiciel est sous licence selon les termes du fichier LICENSE dans le dossier racine de ce composant logiciel.
  * Si aucun fichier LICENSE n'est fourni avec ce logiciel, il est fourni TEL QUEL.
  *
  ******************************************************************************
  */
/* FIN DU CODE UTILISATEUR EN-TETE */

#include "FreeRTOS.h"
#include "task.h"
#include "main.h"
#include "cmsis_os.h"

/* USER CODE BEGIN Includes */
#include "maze.h"
#include "stm32746g_discovery_lcd.h"
#include <string.h>
#include <stdbool.h>
#include "adc.h"
#include "stm32f7xx_hal.h"
#include "stm32f7xx_hal_def.h"
#include "HorombeRGB565.h"
/* USER CODE END Includes */

#define GAME_OVER_DELAY_MS 2000
#define LEVEL_COMPLETE_DELAY_MS 2000
#define BUTTON_DEBOUNCE_MS 200

// Declarations externes
extern ADC_HandleTypeDef hadc1;
extern ADC_HandleTypeDef hadc3;
extern struct {
    int x;
    int y;
    bool eaten;
} points[];

// Mutex pour proteger l'etat du jeu partage
//osMutexId gameMutexHandle;

// Semaphore pour la synchronisation de l'affichage
osSemaphoreId displaySemHandle;

osThreadId tache_jeuHandle;
osThreadId tache_affichageHandle;
osThreadId tache_entreesHandle;
osThreadId tache_fantomeHandle;
osMessageQId queue_PacManHandle;
osMessageQId queue_pointsHandle;
osMessageQId joystickQueueHandle;
osMessageQId vieQueueHandle;

void fonction_jeu(void const * argument);
void fonction_affichage(void const * argument);
void fonction_entrees(void const * argument);
void fonction_fantome(void const * argument);

void MX_FREERTOS_Init(void); /* (regle MISRA C 2004 8.1) */

/* Prototype GetIdleTaskMemory (lie a la prise en charge de l'allocation statique) */
void vApplicationGetIdleTaskMemory( StaticTask_t **ppxIdleTaskTCBBuffer, StackType_t **ppxIdleTaskStackBuffer, uint32_t *pulIdleTaskStackSize );

static StaticTask_t xIdleTaskTCBBuffer;
static StackType_t xIdleStack[configMINIMAL_STACK_SIZE];

void vApplicationGetIdleTaskMemory( StaticTask_t **ppxIdleTaskTCBBuffer, StackType_t **ppxIdleTaskStackBuffer, uint32_t *pulIdleTaskStackSize )
{
  *ppxIdleTaskTCBBuffer = &xIdleTaskTCBBuffer;
  *ppxIdleTaskStackBuffer = &xIdleStack[0];
  *pulIdleTaskStackSize = configMINIMAL_STACK_SIZE;
  /* Espace pour le code utilisateur */
}

/**
  * @brief  Initialisation de FreeRTOS
  * @param  Aucun
  * @retval Aucun
  */
void MX_FREERTOS_Init(void) {
  /* Initialisation utilisateur */

  /* RTOS_MUTEX utilisateur */
  // Creer le mutex pour la protection de l'etat du jeu
  //osMutexDef(gameMutex);
 // gameMutexHandle = osMutexCreate(osMutex(gameMutex));

  // Creer le semaphore pour la synchronisation de l'affichage
  osSemaphoreDef(displaySem);
  displaySemHandle = osSemaphoreCreate(osSemaphore(displaySem), 1);
  /* FIN RTOS_MUTEX utilisateur */

  /* RTOS_SEMAPHORES utilisateur */
  /* Ajouter des semaphores, ... */
  /* FIN RTOS_SEMAPHORES utilisateur */

  /* RTOS_TIMERS utilisateur */
  /* Demarrer les timers, ajouter de nouveaux, ... */
  /* FIN RTOS_TIMERS utilisateur */

  /* Creation des files d'attente */
  /* definition et creation de queue_PacMan */
  osMessageQDef(queue_PacMan, 16, uint16_t);
  queue_PacManHandle = osMessageCreate(osMessageQ(queue_PacMan), NULL);

  /* definition et creation de queue_points */
  osMessageQDef(queue_points, 16, uint16_t);
  queue_pointsHandle = osMessageCreate(osMessageQ(queue_points), NULL);

  /* definition et creation de joystickQueue */
  osMessageQDef(joystickQueue, 32, uint32_t);
  joystickQueueHandle = osMessageCreate(osMessageQ(joystickQueue), NULL);

  /* definition et creation de vieQueue */
  osMessageQDef(vieQueue, 16, uint16_t);
  vieQueueHandle = osMessageCreate(osMessageQ(vieQueue), NULL);

  /* RTOS_QUEUES utilisateur */
  /* Ajouter des files d'attente, ... */
  /* FIN RTOS_QUEUES utilisateur */

  /* Creation des threads */
  /* definition et creation de tache_jeu */
  osThreadDef(tache_jeu, fonction_jeu, osPriorityAboveNormal, 0, 128);
  tache_jeuHandle = osThreadCreate(osThread(tache_jeu), NULL);

  /* definition et creation de tache_affichage */
  osThreadDef(tache_affichage, fonction_affichage, osPriorityNormal, 0, 1024);
  tache_affichageHandle = osThreadCreate(osThread(tache_affichage), NULL);

  /* definition et creation de tache_entrees */
  osThreadDef(tache_entrees, fonction_entrees, osPriorityHigh, 0, 128);
  tache_entreesHandle = osThreadCreate(osThread(tache_entrees), NULL);

  /* definition et creation de tache_fantome */
  osThreadDef(tache_fantome, fonction_fantome, osPriorityNormal, 0, 128);
  tache_fantomeHandle = osThreadCreate(osThread(tache_fantome), NULL);

  /* RTOS_THREADS utilisateur */
  /* Ajouter des threads, ... */
  /* FIN RTOS_THREADS utilisateur */

}

/**
* @brief Fonction implementant le thread tache_jeu.
* @param argument: Non utilise
* @retval Aucun
*/
void fonction_jeu(void const * argument)
{
  /* Fonction utilisateur tache_jeu */

    static uint32_t joystick_v, joystick_h;
    for(;;) {
        switch(etat) {
            case STATE_MENU:
                // Controle des LED en fonction des boutons
                HAL_GPIO_WritePin(LED13_GPIO_Port, LED13_Pin, HAL_GPIO_ReadPin(BP1_GPIO_Port, BP1_Pin));
                HAL_GPIO_WritePin(LED14_GPIO_Port, LED14_Pin, HAL_GPIO_ReadPin(BP2_GPIO_Port, BP2_Pin));
                // Mesure des potentiometres et du joystick
                ReadSensors(&joystick_v, &joystick_h);
                // Transition vers l'etat 1 (jeu) si BP1 est enfonce
                if (!(HAL_GPIO_ReadPin(BP1_GPIO_Port, BP1_Pin))) {
                    HAL_Delay(200);
                    if (!(HAL_GPIO_ReadPin(BP1_GPIO_Port, BP1_Pin))) {
                        InitGame();
                        etat = STATE_GAME_RUNNING;
                    }
                }
                break;
            case STATE_GAME_RUNNING:

                uint32_t current_time = HAL_GetTick();
                // Mise a jour de Pac-Man toutes les 50ms
                if(current_time - last_update_time > 50) {
                    last_update_time = current_time;
                    ReadSensors(&joystick_v, &joystick_h);
                    MovePacMan(&pacman, joystick_h, joystick_v);
                    if (AllPointsEaten()) {
                        etat = STATE_LEVEL_COMPLETE;
                        state_change_delay = HAL_GetTick();
                        break;
                    }
                    if (pacman.lives <= 0) {
                        etat = STATE_GAME_OVER;
                        state_change_delay = HAL_GetTick();
                        break;
                    }
                }
                // Mise a jour des fantomes toutes les 75ms
                if(current_time - ghost_update_time > 75) {
                    ghost_update_time = current_time;
                    MoveGhosts(&pacman);
                }
                // Retour a l'etat 0 si BP1 est enfonce a nouveau
                if (!(HAL_GPIO_ReadPin(BP1_GPIO_Port, BP1_Pin))) {
                    HAL_Delay(200);
                    if (!(HAL_GPIO_ReadPin(BP1_GPIO_Port, BP1_Pin))) {
                        etat = STATE_MENU;
                    }
                }
                break;
            case STATE_GAME_OVER:
                if (HAL_GetTick() - state_change_delay > 2000) {
                    if (!(HAL_GPIO_ReadPin(BP1_GPIO_Port, BP1_Pin))) {
                        HAL_Delay(200);
                        if (!(HAL_GPIO_ReadPin(BP1_GPIO_Port, BP1_Pin))) {
                            etat = STATE_MENU;
                        }
                    }
                }
                break;
            case STATE_LEVEL_COMPLETE:
                if (HAL_GetTick() - state_change_delay > 2000) {
                    if (!(HAL_GPIO_ReadPin(BP1_GPIO_Port, BP1_Pin))) {
                        HAL_Delay(200);
                        if (!(HAL_GPIO_ReadPin(BP1_GPIO_Port, BP1_Pin))) {
                            ResetLevel(&pacman);
                            etat = STATE_GAME_RUNNING;
                        }
                    }
                }
                break;
        }
        vTaskDelay(pdMS_TO_TICKS(20));
    }
  /* Fin fonction utilisateur tache_jeu */
}

/**
* @brief Fonction implementant le thread tache_affichage.
* @param argument: Non utilise
* @retval Aucun
*/
void fonction_affichage(void const * argument)
{
  /* Fonction utilisateur tache_affichage */
  static TS_StateTypeDef TS_State;
  static GameState lastEtat = -1;
  static bool points_erased[MAX_POINTS] = {0};
  for(;;) {
    //if(osMutexWait(gameMutexHandle, osWaitForever) == osOK) {
      GameState localEtat = etat;
      PacMan localPacman = pacman;
      //osMutexRelease(gameMutexHandle);

      // Detecter le changement d'etat pour reinitialiser les couches et le suivi
      if (localEtat != lastEtat) {
        if (localEtat == STATE_GAME_RUNNING) {
          BSP_LCD_SelectLayer(0);
          BSP_LCD_Clear(LCD_COLOR_BLACK);
          DrawMaze(LCD_COLOR_BLUE);
          DrawPoints(LCD_COLOR_YELLOW);
          BSP_LCD_SelectLayer(1);
          BSP_LCD_Clear(0x00000000); // Transparent
          memset(points_erased, 0, sizeof(points_erased));
        } else if (localEtat == STATE_MENU) {
          BSP_LCD_SelectLayer(0);
          BSP_LCD_Clear(LCD_COLOR_BLACK);
          BSP_LCD_SelectLayer(1);
          BSP_LCD_Clear(0x00000000);
        } else {
          BSP_LCD_SelectLayer(0);
          BSP_LCD_Clear(LCD_COLOR_BLACK);
          BSP_LCD_SelectLayer(1);
          BSP_LCD_Clear(0x00000000);
        }
        lastEtat = localEtat;
      }

      switch(localEtat) {
        case STATE_MENU:
          BSP_LCD_SelectLayer(1);
          BSP_LCD_SetTextColor(LCD_COLOR_WHITE);
          BSP_TS_GetState(&TS_State);
          if(TS_State.touchDetected) {
            int x = TS_State.touchX[0];
            int y = TS_State.touchY[0];
            int rayon = 2;
            if (((x - rayon >= 0) && (x + rayon < LCD_LONGUEUR) && (y - rayon >= 0) && (y + rayon < LCD_LARGEUR))) {
              BSP_LCD_FillCircle(x, y, rayon);
            }
          }
          if (HAL_GetTick() - animation_time > 500) {
            animation_time = HAL_GetTick();
            BSP_LCD_SelectLayer(0);
            BSP_LCD_Clear(LCD_COLOR_BLACK);
            BSP_LCD_SetTextColor(LCD_COLOR_YELLOW);
            BSP_LCD_SetBackColor(LCD_COLOR_BLACK);
            BSP_LCD_SetFont(&Font24);
            BSP_LCD_DisplayStringAt(140, 100, (uint8_t*)"PAC-MAN", LEFT_MODE);
            BSP_LCD_SetFont(&Font16);
            BSP_LCD_DisplayStringAt(140, 150, (uint8_t*)"Appuyez sur BP1", LEFT_MODE);
            BSP_LCD_DisplayStringAt(140, 170, (uint8_t*)"pour commencer", LEFT_MODE);
            static bool mouth_open = true;
            if (mouth_open) {
              BSP_LCD_FillCircle(240, 220, 15);
              mouth_open = false;
            } else {
              BSP_LCD_FillCircle(240, 220, 15);
              BSP_LCD_SetTextColor(LCD_COLOR_BLACK);
              Point tri[3] = {
                {240, 220},
                {240+15, 220-10},
                {240+15, 220+10}
              };
              BSP_LCD_FillPolygon(tri, 3);
              BSP_LCD_SetTextColor(LCD_COLOR_YELLOW);
              mouth_open = true;
            }
            BSP_LCD_SelectLayer(1);
            BSP_LCD_Clear(0x00000000);
          }
          break;
        case STATE_GAME_RUNNING:
          // 1. Effacer la couche transparente pour les objets en mouvement
          BSP_LCD_SelectLayer(1);
          BSP_LCD_Clear(0x00000000); // Transparent

          // 2. Dessiner Pac-Man et les fantomes a leur position actuelle

          DrawGameInfo(&pacman);
          DrawPacMan(&pacman, LCD_COLOR_YELLOW);
          DrawGhosts();

          // 3. Pour les points manges, dessiner un cercle noir sur la couche 0 (fond) si pas deja efface
          BSP_LCD_SelectLayer(0);
          for (int i = 0; i < MAX_POINTS; i++) {
            if (points[i].eaten && !points_erased[i]) {
              BSP_LCD_SetTextColor(LCD_COLOR_BLACK);
              BSP_LCD_FillCircle(points[i].x, points[i].y, 2);
              points_erased[i] = true;
            }
          }
          break;
        case STATE_GAME_OVER:
          BSP_LCD_SelectLayer(0);
          BSP_LCD_Clear(LCD_COLOR_BLACK);
          ShowGameOverScreen(localPacman.score);
          break;
        case STATE_LEVEL_COMPLETE:
          BSP_LCD_SelectLayer(0);
          BSP_LCD_Clear(LCD_COLOR_BLACK);
          BSP_LCD_SetTextColor(LCD_COLOR_GREEN);
          BSP_LCD_SetBackColor(LCD_COLOR_BLACK);
          BSP_LCD_SetFont(&Font24);
          BSP_LCD_DisplayStringAt(240, 100, (uint8_t*)"NIVEAU TERMINE!", CENTER_MODE);
          BSP_LCD_SetTextColor(LCD_COLOR_WHITE);
          BSP_LCD_SetFont(&Font16);
          char scoreText[30];
          sprintf(scoreText, "Score: %d", localPacman.score);
          BSP_LCD_DisplayStringAt(240, 150, (uint8_t*)scoreText, CENTER_MODE);
          BSP_LCD_DisplayStringAt(240, 190, (uint8_t*)"Appuyez sur BP1", CENTER_MODE);
          BSP_LCD_DisplayStringAt(240, 210, (uint8_t*)"pour continuer", CENTER_MODE);
          break;
      }
    }
    vTaskDelay(pdMS_TO_TICKS(20));
  }
  /* Fin fonction utilisateur tache_affichage */
}

/**
* @brief Fonction implementant le thread tache_entrees.
* @param argument: Non utilise
* @retval Aucun
*/
void fonction_entrees(void const * argument)
{
  /* Fonction utilisateur tache_entrees */
  // TODO: Implementer la logique d'entree ici
  for(;;) {
    vTaskDelay(pdMS_TO_TICKS(100));
  }
  /* Fin fonction utilisateur tache_entrees */
}

/**
* @brief Fonction implementant le thread tache_fantome.
* @param argument: Non utilise
* @retval Aucun
*/
void fonction_fantome(void const * argument)
{
  /* Fonction utilisateur tache_fantome */
  /* Boucle infinie */
  for(;;)
  {
    osDelay(1);
  }
  /* Fin fonction utilisateur tache_fantome */
}

/* Code d'application prive --------------------------------------------------*/
// Ajouter les prototypes manquants si non inclus depuis l'en-tete

// Ajouter les extern pour les variables partagees si pas deja presents
extern uint32_t last_update_time;
extern uint32_t ghost_update_time;
extern uint32_t state_change_delay;
extern uint32_t animation_time;
